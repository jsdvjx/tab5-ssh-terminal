## main/Kconfig.projbuild
```kconfig
menu "Tab5 SSH Terminal"

    config TAB5_WIFI_SSID
        string "Wi-Fi SSID"
        default "myssid"

    config TAB5_WIFI_PASSWORD
        string "Wi-Fi password"
        default "mypassword"

    config TAB5_SSH_HOST
        string "SSH host (IP or hostname)"
        default "192.168.1.100"

    config TAB5_SSH_PORT
        int "SSH port"
        default 22

    config TAB5_SSH_USER
        string "SSH username"
        default "user"

    config TAB5_SSH_PASSWORD
        string "SSH password"
        default "password"
        help
            Password auth for the skeleton. Switch to
            libssh2_userauth_publickey_frommemory() for key auth later.

    choice TAB5_TERM_FONT
        prompt "Terminal font"
        default TAB5_FONT_MEDIUM
        help
            Cell size determines the grid: the PTY is sized to match, so the
            remote side sees the real cols x rows.

        config TAB5_FONT_SMALL
            bool "unscii-16, 8x16 cells (160x45 grid) — dense"
        config TAB5_FONT_MEDIUM
            bool "JetBrains Mono 20, 12x24 cells (106x30 grid)"
        config TAB5_FONT_LARGE
            bool "JetBrains Mono 30, 18x36 cells (71x20 grid)"
    endchoice

    config TAB5_SSH_COMMAND
        string "Command to run after login (empty = interactive shell)"
        default ""
        help
            e.g. "tmux new -A -s tab5" to get session persistence across
            reconnects.

endmenu
```

## sdkconfig.defaults
```kconfig
CONFIG_IDF_TARGET="esp32p4"

# Flash / partitions
CONFIG_ESPTOOLPY_FLASHSIZE_16MB=y
CONFIG_PARTITION_TABLE_CUSTOM=y
CONFIG_PARTITION_TABLE_CUSTOM_FILENAME="partitions.csv"

# PSRAM (32MB hex-mode on Tab5; required by the MIPI-DSI framebuffer)
CONFIG_SPIRAM=y
CONFIG_SPIRAM_MODE_HEX=y
CONFIG_SPIRAM_SPEED_200M=y
CONFIG_IDF_EXPERIMENTAL_FEATURES=y
CONFIG_SPIRAM_MALLOC_ALWAYSINTERNAL=256

# L2 cache — recommended for MIPI-DSI throughput
CONFIG_CACHE_L2_CACHE_256KB=y
CONFIG_CACHE_L2_CACHE_LINE_128B=y

# Wi-Fi goes through the ESP32-C6 via esp_hosted (SDIO); slave target
CONFIG_ESP_WIFI_REMOTE_ENABLED=y

CONFIG_FREERTOS_HZ=1000
CONFIG_COMPILER_OPTIMIZATION_PERF=y
CONFIG_ESP_MAIN_TASK_STACK_SIZE=8192

# LVGL
CONFIG_LV_USE_FONT_UNSCII_16=y
CONFIG_LV_FONT_UNSCII_16=y

# Tab5 P4<->C6 SDIO pins (differ from esp_hosted P4 defaults; from M5Stack docs)
CONFIG_ESP_HOSTED_PRIV_SDIO_PIN_CLK_SLOT_1=12
CONFIG_ESP_HOSTED_PRIV_SDIO_PIN_CMD_SLOT_1=13
CONFIG_ESP_HOSTED_PRIV_SDIO_PIN_D0_SLOT_1=11
CONFIG_ESP_HOSTED_PRIV_SDIO_PIN_D1_4BIT_BUS_SLOT_1=10
CONFIG_ESP_HOSTED_PRIV_SDIO_PIN_D2_4BIT_BUS_SLOT_1=9
CONFIG_ESP_HOSTED_PRIV_SDIO_PIN_D3_4BIT_BUS_SLOT_1=8
CONFIG_ESP_HOSTED_SDIO_GPIO_RESET_SLAVE=15
CONFIG_ESP_HOSTED_SDIO_RESET_ACTIVE_HIGH=y

# Runtime-loaded fonts from SD asset pack
CONFIG_LV_USE_FS_MEMFS=y
CONFIG_LV_FS_MEMFS_LETTER=77

CONFIG_BSP_SD_FORMAT_ON_MOUNT_FAIL=y
CONFIG_FATFS_LFN_HEAP=y

# LVGL: clib malloc (big font allocs must reach PSRAM) + FAT long names
CONFIG_LV_USE_CLIB_MALLOC=y
CONFIG_LV_USE_CLIB_STRING=y
CONFIG_LV_USE_CLIB_SPRINTF=y
# 32-bit glyph bitmap_index: SD binfonts >1MB (cjkfull24.bin glyf=2.78MB)
# otherwise glyphs past 1MB wrap mod 2^20 -> horizontal stripe garbage
CONFIG_LV_FONT_FMT_TXT_LARGE=y
CONFIG_FATFS_LFN_HEAP=y

# BLE provisioning: NimBLE host on the P4, controller on the C6 via
# esp_hosted VHCI (HCI over SDIO). See main/ble_prov.c.
CONFIG_BT_ENABLED=y
CONFIG_BT_CONTROLLER_DISABLED=y
CONFIG_BT_NIMBLE_ENABLED=y
CONFIG_BT_NIMBLE_TRANSPORT_UART=n
CONFIG_ESP_HOSTED_ENABLE_BT_NIMBLE=y
CONFIG_ESP_HOSTED_NIMBLE_HCI_VHCI=y
CONFIG_BT_NIMBLE_ATT_PREFERRED_MTU=256

# Task table for the local shell `ps` command
CONFIG_FREERTOS_USE_TRACE_FACILITY=y

# Full-screen home panel (main/ui_home.c): bigger montserrat sizes for the
# wordmark/clock, and lv_snapshot for GET /shot?full=1 remote UI review.
CONFIG_LV_FONT_MONTSERRAT_20=y
CONFIG_LV_FONT_MONTSERRAT_28=y
CONFIG_LV_USE_SNAPSHOT=y
```
